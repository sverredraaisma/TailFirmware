## sdkconfig.defaults
```kconfig
# Bluetooth
CONFIG_BT_ENABLED=y
CONFIG_BT_NIMBLE_ENABLED=y

# Only peripheral role needed
CONFIG_BT_NIMBLE_ROLE_CENTRAL=n
CONFIG_BT_NIMBLE_ROLE_OBSERVER=n
CONFIG_BT_NIMBLE_ROLE_BROADCASTER=n

# Security
CONFIG_BT_NIMBLE_SM_LEGACY=y
CONFIG_BT_NIMBLE_SM_SC=y

# USB serial for debug output (ESP32-C3 built-in USB-Serial-JTAG)
CONFIG_ESP_CONSOLE_USB_SERIAL_JTAG=y
```
